#include "think.h"

const uint16_t PROGMEM keymaps[][MATRIX_ROWS][MATRIX_COLS] = {

  [0] = LAYOUT(
	KC_ESC, KC_F2, KC_F3, KC_F4, KC_F5, KC_F6, KC_F7,
		KC_GRV, KC_1, KC_2, KC_3, KC_4, KC_5, KC_6,
		KC_TAB, KC_Q, KC_W, KC_E, KC_R, KC_T, KC_Y,
		KC_CAPS, KC_A, KC_S, KC_D, KC_F, KC_G, KC_H,
		KC_LSFT, KC_Z, KC_X, KC_C, KC_V, KC_B, KC_N,
		KC_LCTL, KC_LGUI, KC_LALT, KC_SPC, KC_SPC),

  [1] = LAYOUT(
 	KC_TRNS, KC_TRNS, KC_TRNS, KC_TRNS, KC_TRNS, KC_TRNS, KC_TRNS,
		KC_TRNS, KC_TRNS, KC_TRNS, KC_TRNS, KC_TRNS, KC_TRNS, KC_TRNS,
		KC_TRNS, KC_TRNS, KC_TRNS, KC_TRNS, KC_TRNS, KC_TRNS, KC_TRNS,
		KC_TRNS, KC_TRNS, KC_TRNS, KC_TRNS, KC_TRNS, KC_TRNS, KC_TRNS,
		KC_TRNS, KC_TRNS, KC_TRNS, KC_TRNS, KC_TRNS, KC_TRNS, KC_TRNS,
		KC_TRNS, KC_TRNS, KC_TRNS, KC_TRNS, KC_TRNS),

  [2] = LAYOUT(
  	KC_TRNS, KC_TRNS, KC_TRNS, KC_TRNS, KC_TRNS, KC_TRNS, KC_TRNS,
		KC_TRNS, KC_TRNS, KC_TRNS, KC_TRNS, KC_TRNS, KC_TRNS, KC_TRNS,
		KC_TRNS, KC_TRNS, KC_TRNS, KC_TRNS, KC_TRNS, KC_TRNS, KC_TRNS,
		KC_TRNS, KC_TRNS, KC_TRNS, KC_TRNS, KC_TRNS, KC_TRNS, KC_TRNS,
		KC_TRNS, KC_TRNS, KC_TRNS, KC_TRNS, KC_TRNS, KC_TRNS, KC_TRNS,
		KC_TRNS, KC_TRNS, KC_TRNS, KC_TRNS, KC_TRNS),

  [3] = LAYOUT(
 	KC_TRNS, KC_TRNS, KC_TRNS, KC_TRNS, KC_TRNS, KC_TRNS, KC_TRNS,
		KC_TRNS, KC_TRNS, KC_TRNS, KC_TRNS, KC_TRNS, KC_TRNS, KC_TRNS,
		KC_TRNS, KC_TRNS, KC_TRNS, KC_TRNS, KC_TRNS, KC_TRNS, KC_TRNS,
		KC_TRNS, KC_TRNS, KC_TRNS, KC_TRNS, KC_TRNS, KC_TRNS, KC_TRNS,
		KC_TRNS, KC_TRNS, KC_TRNS, KC_TRNS, KC_TRNS, KC_TRNS, KC_TRNS,
		KC_TRNS, KC_TRNS, KC_TRNS, KC_TRNS, KC_TRNS)

};

/* OLED */
#ifdef OLED_DRIVER_ENABLE

bool caps_lock = false;
bool logo_flip = false;
uint16_t oled_timer;
uint16_t flip_timer;

static const char PROGMEM logo_lower_1[] = {
  0x00, 0x00, 0x00, 0x00, 0x00, 0x00, 0x00, 0x00, 0xf8, 0xf8, 0xf8, 0xf8, 0xf8, 0xf8, 0xf8, 0xf8,
  0x00, 0x00, 0x00, 0x00, 0x00, 0x00, 0x00, 0x00, 0x00, 0x00, 0x00, 0x00, 0xf8, 0xf8, 0xf8, 0xf8,
  0xf8, 0xf8, 0xf8, 0xf8, 0x00, 0x00, 0x00, 0x00, 0x00, 0x00, 0x00, 0x00, 0x00, 0x00, 0x00, 0x00,
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  0x00, 0x00, 0x00, 0x00, 0x07, 0x07, 0x07, 0x07, 0x7f, 0x7f, 0x7f, 0x7f, 0x78, 0x78, 0x78, 0x78
};

static const char PROGMEM logo_lower_2[] = {
  0x00, 0x00, 0x00, 0x00, 0x00, 0x00, 0x00, 0x00, 0xf8, 0xf8, 0xf8, 0xf8, 0xf8, 0xf8, 0xf8, 0xf8,
  0x00, 0x00, 0x00, 0x00, 0x00, 0x00, 0x00, 0x00, 0x00, 0x00, 0x00, 0x00, 0xf8, 0xf8, 0xf8, 0xf8,
  0xf8, 0xf8, 0xf8, 0xf8, 0x00, 0x00, 0x00, 0x00, 0x00, 0x00, 0x00, 0x00, 0x00, 0x00, 0x00, 0x00,
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  0x00, 0x00, 0x00, 0x00, 0x07, 0x07, 0x07, 0x07, 0x7f, 0x7f, 0x7f, 0x7f, 0x78, 0x78, 0x78, 0x78
};

static const char PROGMEM logo_upper_1[] = {
  0x78, 0x78, 0x78, 0x78, 0x78, 0x78, 0x78, 0x78, 0xf8, 0xf8, 0xf8, 0xf8, 0xf8, 0xf8, 0xf8, 0xf8,
  0x78, 0x78, 0x78, 0x78, 0x78, 0x78, 0x78, 0x78, 0x00, 0x00, 0x00, 0x00, 0xf8, 0xf8, 0xf8, 0xf8,
  0xf8, 0xf8, 0xf8, 0xf8, 0x00, 0x00, 0x00, 0x00, 0x00, 0x00, 0x00, 0x00, 0xf8, 0xf8, 0xf8, 0xf8,
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  0x07, 0x07, 0x07, 0x07, 0x7f, 0x7f, 0x7f, 0x7f, 0x7f, 0x7f, 0x7f, 0x7f, 0x78, 0x78, 0x78, 0x78
};

static const char PROGMEM logo_upper_2[] = {
  0x78, 0x78, 0x78, 0x78, 0x78, 0x78, 0x78, 0x78, 0xf8, 0xf8, 0xf8, 0xf8, 0xf8, 0xf8, 0xf8, 0xf8,
  0x78, 0x78, 0x78, 0x78, 0x78, 0x78, 0x78, 0x78, 0x00, 0x00, 0x00, 0x00, 0xf8, 0xf8, 0xf8, 0xf8,
  0xf8, 0xf8, 0xf8, 0xf8, 0x00, 0x00, 0x00, 0x00, 0x00, 0x00, 0x00, 0x00, 0xf8, 0xf8, 0xf8, 0xf8,
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  0x07, 0x07, 0x07, 0x07, 0x7f, 0x7f, 0x7f, 0x7f, 0x7f, 0x7f, 0x7f, 0x7f, 0x78, 0x78, 0x78, 0x78
};

static void render_logo(bool immediate) {
  if (immediate || timer_elapsed(flip_timer) > 500) {
    if (logo_flip) {
      if (caps_lock) {
        oled_write_raw_P(logo_upper_1, sizeof(logo_upper_1));
      } else {
        oled_write_raw_P(logo_lower_1, sizeof(logo_lower_1));
      }
    } else {
      if (caps_lock) {
        oled_write_raw_P(logo_upper_2, sizeof(logo_upper_2));
      } else {
        oled_write_raw_P(logo_lower_2, sizeof(logo_lower_2));
      }
    }
    flip_timer = timer_read();
    logo_flip = !logo_flip;
  }

};

void oled_task_user(void) {
  led_t led_state = host_keyboard_led_state();
  if (led_state.caps_lock != caps_lock) {
    caps_lock = led_state.caps_lock;
    oled_timer = timer_read();
    render_logo(true);
  } else if (timer_elapsed(oled_timer) < OLED_TIMEOUT) {
    render_logo(true);
  } else {
  }
};

#endif

/* DIP Switch */
#ifdef DIP_SWITCH_ENABLE

void dip_switch_update_user(uint8_t index, bool active) {
  switch (index) {
    case 0:
      if(active) {
        toggle_led_mode(false);
      } else {
        toggle_led_mode(true);
      }
      break;
    case 1:
      if(active) {
        #ifdef AUDIO_ENABLE
          audio_off();
        #endif
      } else {
        #ifdef AUDIO_ENABLE
          audio_on();
        #endif
      }
      break;
  }
}

#endif
