#include "think.h"
#ifdef AUDIO_ENABLE
#include "audio.h"
#endif

typedef union {
  uint32_t raw;
  struct {
    bool led_mode_on: true;
  };
} user_config_t;

user_config_t user_config;

enum dg_custom_keycodes {
  LED_ON = SAFE_RANGE,
  LED_OFF,
};

const uint16_t PROGMEM keymaps[][MATRIX_ROWS][MATRIX_COLS] = {

    [0] = LAYOUT(KC_ESC, KC_Q),

    [1] = LAYOUT(KC_GRV, KC_1)};

void toggle_led_mode(bool state) {
  user_config.led_mode_on = state;
  eeconfig_update_user(user_config.raw);
}

void keyboard_post_init_user(void) {
  user_config.raw = eeconfig_read_user();
};

bool process_record_user(uint16_t keycode, keyrecord_t *record) {
  switch (keycode) {
    case LED_ON:
      toggle_led_mode(true);
      break;

    case LED_OFF:
      toggle_led_mode(false);
      break;
  }
  return true;
}

void led_set_user(uint8_t usb_led) {
  if (user_config.led_mode_on) {
    if (usb_led & (1 << USB_LED_CAPS_LOCK)) {
      DDRB |= (1 << 0); PORTB &= ~(1 << 0);
    } else {
      DDRB &= ~(1 << 0); PORTB &= ~(1 << 0);
    }
  }
}

/* Audio */
#ifdef AUDIO_ENABLE

float tone_caps_on[][2] = SONG(Q__NOTE(_C4), Q__NOTE(_G4));
float tone_caps_off[][2] = SONG(Q__NOTE(_G4), Q__NOTE(_C4));

bool led_update_user(led_t led_state) {
  static uint8_t caps_state = 0;
  if (caps_state != led_state.caps_lock) {
    if (led_state.caps_lock) {
      PLAY_SONG(tone_caps_on);
    } else {
      PLAY_SONG(tone_caps_off);
    }
    caps_state = led_state.caps_lock;
  }
  return true;
};

#endif

/* OLED */
#ifdef OLED_DRIVER_ENABLE

bool caps_lock = false;
bool logo_flip = false;
uint16_t oled_timer;
uint16_t flip_timer;

static const char PROGMEM logo_lower_1[] = {
  0x00, 0x00, 0x00, 0x00, 0x00, 0x00, 0x00, 0x00, 0xf8, 0xf8, 0xf8, 0xf8, 0xf8, 0xf8, 0xf8, 0xf8,
  0x00, 0x00, 0x00, 0x00, 0x00, 0x00, 0x00, 0x00, 0x00, 0x00, 0x00, 0x00, 0xf8, 0xf8, 0xf8, 0xf8,
  0xf8, 0xf8, 0xf8, 0xf8, 0x00, 0x00, 0x00, 0x00, 0x00, 0x00, 0x00, 0x00, 0x00, 0x00, 0x00, 0x00,
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  0x00, 0x00, 0x00, 0x00, 0x07, 0x07, 0x07, 0x07, 0x7f, 0x7f, 0x7f, 0x7f, 0x78, 0x78, 0x78, 0x78
};

static const char PROGMEM logo_lower_2[] = {
  0x00, 0x00, 0x00, 0x00, 0x00, 0x00, 0x00, 0x00, 0xf8, 0xf8, 0xf8, 0xf8, 0xf8, 0xf8, 0xf8, 0xf8,
  0x00, 0x00, 0x00, 0x00, 0x00, 0x00, 0x00, 0x00, 0x00, 0x00, 0x00, 0x00, 0xf8, 0xf8, 0xf8, 0xf8,
  0xf8, 0xf8, 0xf8, 0xf8, 0x00, 0x00, 0x00, 0x00, 0x00, 0x00, 0x00, 0x00, 0x00, 0x00, 0x00, 0x00,
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  0x00, 0x00, 0x00, 0x00, 0x07, 0x07, 0x07, 0x07, 0x7f, 0x7f, 0x7f, 0x7f, 0x78, 0x78, 0x78, 0x78
};

static const char PROGMEM logo_upper_1[] = {
  0x78, 0x78, 0x78, 0x78, 0x78, 0x78, 0x78, 0x78, 0xf8, 0xf8, 0xf8, 0xf8, 0xf8, 0xf8, 0xf8, 0xf8,
  0x78, 0x78, 0x78, 0x78, 0x78, 0x78, 0x78, 0x78, 0x00, 0x00, 0x00, 0x00, 0xf8, 0xf8, 0xf8, 0xf8,
  0xf8, 0xf8, 0xf8, 0xf8, 0x00, 0x00, 0x00, 0x00, 0x00, 0x00, 0x00, 0x00, 0xf8, 0xf8, 0xf8, 0xf8,
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  0x07, 0x07, 0x07, 0x07, 0x7f, 0x7f, 0x7f, 0x7f, 0x7f, 0x7f, 0x7f, 0x7f, 0x78, 0x78, 0x78, 0x78
};

static const char PROGMEM logo_upper_2[] = {
  0x78, 0x78, 0x78, 0x78, 0x78, 0x78, 0x78, 0x78, 0xf8, 0xf8, 0xf8, 0xf8, 0xf8, 0xf8, 0xf8, 0xf8,
  0x78, 0x78, 0x78, 0x78, 0x78, 0x78, 0x78, 0x78, 0x00, 0x00, 0x00, 0x00, 0xf8, 0xf8, 0xf8, 0xf8,
  0xf8, 0xf8, 0xf8, 0xf8, 0x00, 0x00, 0x00, 0x00, 0x00, 0x00, 0x00, 0x00, 0xf8, 0xf8, 0xf8, 0xf8,
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  0x07, 0x07, 0x07, 0x07, 0x7f, 0x7f, 0x7f, 0x7f, 0x7f, 0x7f, 0x7f, 0x7f, 0x78, 0x78, 0x78, 0x78
};

static void render_logo(bool immediate) {
  if (immediate || timer_elapsed(flip_timer) > 500) {
    oled_on();
    if (logo_flip) {
      if (caps_lock) {
        oled_write_raw_P(logo_upper_1, sizeof(logo_upper_1));
      } else {
        oled_write_raw_P(logo_lower_1, sizeof(logo_lower_1));
      }
    } else {
      if (caps_lock) {
        oled_write_raw_P(logo_upper_2, sizeof(logo_upper_2));
      } else {
        oled_write_raw_P(logo_lower_2, sizeof(logo_lower_2));
      }
    }
    flip_timer = timer_read();
    logo_flip = !logo_flip;
  }
};

void oled_task_user(void) {
  led_t led_state = host_keyboard_led_state();
  if (led_state.caps_lock != caps_lock) {
    caps_lock = led_state.caps_lock;
    oled_timer = timer_read();
    render_logo(true);
  } else if (timer_elapsed(oled_timer) < OLED_TIMEOUT) {
    render_logo(false);
  } else {
    oled_off();
  }
};

#endif

/* DIP Switch */
#ifdef DIP_SWITCH_ENABLE

void dip_switch_update_user(uint8_t index, bool active) {
  switch (index) {
    case 0:
      if(active) {
        toggle_led_mode(false);
      } else {
        toggle_led_mode(true);
      }
      break;
    case 1:
      if(active) {
        #ifdef AUDIO_ENABLE
          audio_off();
        #endif
      } else { 
        #ifdef AUDIO_ENABLE
          audio_on();
        #endif
      }
      break;
  }
}

#endif
