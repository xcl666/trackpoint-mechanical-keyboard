#include "think.h"
#ifdef AUDIO_ENABLE
#include "audio.h"
#endif

typedef union {
  uint32_t raw;
  struct {
    bool led_mode_on: true;
  };
} user_config_t;

user_config_t user_config;

enum dg_custom_keycodes {
  LED_ON = SAFE_RANGE,
  LED_OFF,
};

const uint16_t PROGMEM keymaps[][MATRIX_ROWS][MATRIX_COLS] = {

  [0] = LAYOUT(
    KC_ESC,  KC_Q,    KC_W,    KC_E,    KC_R,    KC_T,    KC_Y,    KC_U,    KC_I,    KC_O,    KC_P,    KC_BSPC,
    KC_TAB,  KC_A,    KC_S,    KC_D,    KC_F,    KC_G,    KC_H,    KC_J,    KC_K,    KC_L,             KC_ENT,
    KC_LSFT,          KC_Z,    KC_X,    KC_C,    KC_V,    KC_B,    KC_N,    KC_M,    KC_CAPS, KC_UP,   KC_RSFT,
    KC_LCTL, KC_LALT,          KC_LGUI,          KC_SPC,           MO(1),   MO(2),   KC_LEFT, KC_DOWN, KC_RGHT),

  [1] = LAYOUT(
    KC_GRV,  KC_1,    KC_2,    KC_3,    KC_4,    KC_5,    KC_6,    KC_7,    KC_8,    KC_9,    KC_0,    KC_BSLS,
    KC_TRNS, KC_INS,  KC_HOME, KC_PGUP, KC_MINS, KC_EQL,  KC_LBRC, KC_RBRC, KC_SCLN, KC_QUOT,          KC_TRNS,
    KC_TRNS,          KC_DEL,  KC_END,  KC_PGDN, KC_TRNS, KC_COMM, KC_DOT,  KC_SLSH, KC_TRNS, KC_TRNS, KC_TRNS,
    KC_TRNS, KC_TRNS,          KC_TRNS,          KC_TRNS,          KC_TRNS, KC_TRNS, KC_TRNS, KC_TRNS, KC_TRNS),

  [2] = LAYOUT(
    KC_F1,   KC_F2,   KC_F3,   KC_F4,   KC_F5,   KC_F6,   KC_F7,   KC_F8,   KC_F9,   KC_F10,  KC_F11,  KC_F12,
    KC_TRNS, KC_BTN1, KC_BTN3, KC_BTN2, KC_TRNS, KC_TRNS, KC_BRID, KC_BRIU, KC_BTN1, KC_BTN3,          KC_BTN2,
    KC_TRNS,          KC_PSCR, KC_SLCK, KC_PAUS, KC_TRNS, KC_MUTE, KC_VOLD, KC_VOLU, KC_TRNS, AU_ON,   KC_TRNS,
    KC_TRNS, KC_TRNS,          KC_TRNS,          RESET,            KC_TRNS, KC_TRNS, LED_OFF, AU_OFF,  LED_ON),

  [3] = LAYOUT(
    KC_NO,   KC_NO,   KC_NO,   KC_NO,   KC_NO,   KC_NO,   KC_NO,   KC_NO,   KC_NO,   KC_NO,   KC_NO,   KC_NO,
    KC_NO,   KC_NO,   KC_NO,   KC_NO,   KC_NO,   KC_NO,   KC_NO,   KC_NO,   KC_NO,   KC_NO,            KC_NO,
    KC_NO,            KC_NO,   KC_NO,   KC_NO,   KC_NO,   KC_NO,   KC_NO,   KC_NO,   KC_NO,   KC_NO,   KC_NO,
    KC_NO,   KC_NO,            KC_NO,            KC_NO,            KC_NO,   KC_NO,   KC_NO,   KC_NO,   KC_NO)

};

void toggle_led_mode(bool state) {
  user_config.led_mode_on = state;
  eeconfig_update_user(user_config.raw);
}

void keyboard_post_init_user(void) {
  user_config.raw = eeconfig_read_user();
};

bool process_record_user(uint16_t keycode, keyrecord_t *record) {
  switch (keycode) {
    case LED_ON:
      toggle_led_mode(true);
      break;

    case LED_OFF:
      toggle_led_mode(false);
      break;
  }
  return true;
}

void led_set_user(uint8_t usb_led) {
  if (user_config.led_mode_on) {
    if (usb_led & (1 << USB_LED_CAPS_LOCK)) {
      DDRB |= (1 << 0); PORTB &= ~(1 << 0);
    } else {
      DDRB &= ~(1 << 0); PORTB &= ~(1 << 0);
    }
  }
}

/* Audio */
#ifdef AUDIO_ENABLE

float tone_caps_on[][2] = SONG(Q__NOTE(_C4), Q__NOTE(_G4));
float tone_caps_off[][2] = SONG(Q__NOTE(_G4), Q__NOTE(_C4));

bool led_update_user(led_t led_state) {
  static uint8_t caps_state = 0;
  if (caps_state != led_state.caps_lock) {
    if (led_state.caps_lock) {
      PLAY_SONG(tone_caps_on);
    } else {
      PLAY_SONG(tone_caps_off);
    }
    caps_state = led_state.caps_lock;
  }
  return true;
};

#endif

/* OLED */
#ifdef OLED_DRIVER_ENABLE

bool caps_lock = false;
bool logo_flip = false;
uint16_t oled_timer;
uint16_t flip_timer;

static const char PROGMEM logo_lower_1[] = {
  0x00, 0x00, 0x00, 0x00, 0x00, 0x00, 0x00, 0x00, 0xf8, 0xf8, 0xf8, 0xf8, 0xf8, 0xf8, 0xf8, 0xf8,
  0x00, 0x00, 0x00, 0x00, 0x00, 0x00, 0x00, 0x00, 0x00, 0x00, 0x00, 0x00, 0xf8, 0xf8, 0xf8, 0xf8,
  0xf8, 0xf8, 0xf8, 0xf8, 0x00, 0x00, 0x00, 0x00, 0x00, 0x00, 0x00, 0x00, 0x00, 0x00, 0x00, 0x00,
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  0x00, 0x00, 0x00, 0x00, 0x07, 0x07, 0x07, 0x07, 0x7f, 0x7f, 0x7f, 0x7f, 0x78, 0x78, 0x78, 0x78
};

static const char PROGMEM logo_lower_2[] = {
  0x00, 0x00, 0x00, 0x00, 0x00, 0x00, 0x00, 0x00, 0xf8, 0xf8, 0xf8, 0xf8, 0xf8, 0xf8, 0xf8, 0xf8,
  0x00, 0x00, 0x00, 0x00, 0x00, 0x00, 0x00, 0x00, 0x00, 0x00, 0x00, 0x00, 0xf8, 0xf8, 0xf8, 0xf8,
  0xf8, 0xf8, 0xf8, 0xf8, 0x00, 0x00, 0x00, 0x00, 0x00, 0x00, 0x00, 0x00, 0x00, 0x00, 0x00, 0x00,
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  0x00, 0x00, 0x00, 0x00, 0x07, 0x07, 0x07, 0x07, 0x7f, 0x7f, 0x7f, 0x7f, 0x78, 0x78, 0x78, 0x78
};

static const char PROGMEM logo_upper_1[] = {
  0x78, 0x78, 0x78, 0x78, 0x78, 0x78, 0x78, 0x78, 0xf8, 0xf8, 0xf8, 0xf8, 0xf8, 0xf8, 0xf8, 0xf8,
  0x78, 0x78, 0x78, 0x78, 0x78, 0x78, 0x78, 0x78, 0x00, 0x00, 0x00, 0x00, 0xf8, 0xf8, 0xf8, 0xf8,
  0xf8, 0xf8, 0xf8, 0xf8, 0x00, 0x00, 0x00, 0x00, 0x00, 0x00, 0x00, 0x00, 0xf8, 0xf8, 0xf8, 0xf8,
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  0x07, 0x07, 0x07, 0x07, 0x7f, 0x7f, 0x7f, 0x7f, 0x7f, 0x7f, 0x7f, 0x7f, 0x78, 0x78, 0x78, 0x78
};

static const char PROGMEM logo_upper_2[] = {
  0x78, 0x78, 0x78, 0x78, 0x78, 0x78, 0x78, 0x78, 0xf8, 0xf8, 0xf8, 0xf8, 0xf8, 0xf8, 0xf8, 0xf8,
  0x78, 0x78, 0x78, 0x78, 0x78, 0x78, 0x78, 0x78, 0x00, 0x00, 0x00, 0x00, 0xf8, 0xf8, 0xf8, 0xf8,
  0xf8, 0xf8, 0xf8, 0xf8, 0x00, 0x00, 0x00, 0x00, 0x00, 0x00, 0x00, 0x00, 0xf8, 0xf8, 0xf8, 0xf8,
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  0x07, 0x07, 0x07, 0x07, 0x7f, 0x7f, 0x7f, 0x7f, 0x7f, 0x7f, 0x7f, 0x7f, 0x78, 0x78, 0x78, 0x78
};

static void render_logo(bool immediate) {
  if (immediate || timer_elapsed(flip_timer) > 500) {
    oled_on();
    if (logo_flip) {
      if (caps_lock) {
        oled_write_raw_P(logo_upper_1, sizeof(logo_upper_1));
      } else {
        oled_write_raw_P(logo_lower_1, sizeof(logo_lower_1));
      }
    } else {
      if (caps_lock) {
        oled_write_raw_P(logo_upper_2, sizeof(logo_upper_2));
      } else {
        oled_write_raw_P(logo_lower_2, sizeof(logo_lower_2));
      }
    }
    flip_timer = timer_read();
    logo_flip = !logo_flip;
  }
};

void oled_task_user(void) {
  led_t led_state = host_keyboard_led_state();
  if (led_state.caps_lock != caps_lock) {
    caps_lock = led_state.caps_lock;
    oled_timer = timer_read();
    render_logo(true);
  } else if (timer_elapsed(oled_timer) < OLED_TIMEOUT) {
    render_logo(false);
  } else {
    oled_off();
  }
};

#endif

/* DIP Switch */
#ifdef DIP_SWITCH_ENABLE

void dip_switch_update_user(uint8_t index, bool active) {
  switch (index) {
    case 0:
      if(active) {
        toggle_led_mode(false);
      } else {
        toggle_led_mode(true);
      }
      break;
    case 1:
      if(active) {
        #ifdef AUDIO_ENABLE
          audio_off();
        #endif
      } else { 
        #ifdef AUDIO_ENABLE
          audio_on();
        #endif
      }
      break;
  }
}

#endif
